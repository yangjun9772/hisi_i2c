## Kconfig
```kconfig
#
# TEST I2C
#

menu "TEST CONFIG"

comment "Test the i2c"

config TEST_I2C
	tristate "test i2c driver sample"
	default n
	help
		y for support, m for build ko, n for non

endmenu
```
